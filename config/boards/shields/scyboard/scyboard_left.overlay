#include "scyboard.dtsi"

&kscan0 {
        col-gpios 
            = <&pro_micro 21 GPIO_ACTIVE_HIGH>  // COL 0 (outer)
            , <&pro_micro 20 GPIO_ACTIVE_HIGH>  // COL 1 (pinky)
            , <&pro_micro 19 GPIO_ACTIVE_HIGH>  // COL 2 (ring)
            , <&pro_micro 18 GPIO_ACTIVE_HIGH>  // COL 3 (middle)
            , <&pro_micro 15 GPIO_ACTIVE_HIGH>  // COL 4 (index)
            , <&pro_micro 14 GPIO_ACTIVE_HIGH>  // COL 5 (inner)
            ;
};
