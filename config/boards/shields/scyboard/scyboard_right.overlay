#include "scyboard.dtsi"

&default_transform {
    col-offset = <6>;
};

&kscan0 {
        col-gpios 
            = <&pro_micro 14 GPIO_ACTIVE_HIGH>  // COL 11 (outer)
            , <&pro_micro 15 GPIO_ACTIVE_HIGH>  // COL 10 (pinky)
            , <&pro_micro 18 GPIO_ACTIVE_HIGH>  // COL 9 (ring)
            , <&pro_micro 19 GPIO_ACTIVE_HIGH>  // COL 8 (middle)
            , <&pro_micro 20 GPIO_ACTIVE_HIGH>  // COL 7 (index)
            , <&pro_micro 21 GPIO_ACTIVE_HIGH>  // COL 6 (inner)
            ;
};
