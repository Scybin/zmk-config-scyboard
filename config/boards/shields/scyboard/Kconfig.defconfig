## config/boards/shields/scyboard/Kconfig.defconfig
```kconfig
if SHIELD_SCYBOARD_LEFT

config ZMK_KEYBOARD_NAME
	default "scyboard"

config ZMK_SPLIT_ROLE_CENTRAL
	default y

config LOG
	default y

config LOG_MODE_DEFERRED
	default y

config LOG_BACKEND_USB
	default y

endif

if SHIELD_SCYBOARD_LEFT || SHIELD_SCYBOARD_RIGHT

config ZMK_SPLIT
	default y

endif
```

## config/boards/shields/scyboard/Kconfig.shield
```kconfig
config SHIELD_SCYBOARD_LEFT
		def_bool $(shields_list_contains,scyboard_left)

config SHIELD_SCYBOARD_RIGHT
		def_bool $(shields_list_contains,scyboard_right)
```

## config/west.yml
```yaml
manifest:
  remotes:
    - name: zmkfirmware
      url-base: https://github.com/zmkfirmware
    - name: scybin
      url-base: https://github.com/scybin
  projects:
    - name: zmk
      remote: zmkfirmware
      revision: main
      import: app/west.yml
    - name: zmk-keyboard-scyboard
      remote: scybin
      revision: main
  self:
    path: config
```
